ENTRY(_start)

SECTIONS
{
    . = 0x8000;      /* Kernel load address for 32-bit ARM (kernel.img) */
    .text : { KEEP(*(.text.boot)) *(.text .text.*) }
    .rodata : { *(.rodata .rodata.*) }
    .data : { *(.data .data.*) }

    .bss (NOLOAD) : ALIGN(4) {
        __bss_start = .;
        *(.bss .bss.*)
        *(COMMON)
        __bss_end = .;
    }

    /DISCARD/ : { *(.ARM.exidx*) }
}
